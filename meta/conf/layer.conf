## meta/conf/layer.conf
```bitbake
# We have a conf and classes directory, add to BBPATH
BBPATH .= ":${LAYERDIR}"

# We have recipes-* directories, add to BBFILES
BBFILES += "${LAYERDIR}/recipes-*/*/*.bb \
	${LAYERDIR}/recipes-*/*/*.bbappend"

BBFILE_COLLECTIONS += "pcbd-tegra"
BBFILE_PATTERN_pcbd-tegra = "^${LAYERDIR}/"
BBFILE_PRIORITY_pcbd-tegra = "6"

RM_WORK_EXCLUDE += "linux-tegra busybox nvgstapps"

ROOTFSPART_SIZE = "3984588800"
TEGRAFLASH_SDCARD_SIZE = "4100M"

KERNEL_DEVICETREE ?= "_ddot_/_ddot_/_ddot_/_ddot_/nvidia/platform/t210/batuu/kernel-dts/tegra210-p3448-0003-p3542-0000.dtb"
KERNEL_DEVICETREE += "_ddot_/_ddot_/_ddot_/_ddot_/nvidia/platform/t210/batuu/kernel-dts/camera-overlay-dione1280.dtb"
KERNEL_DEVICETREE += "_ddot_/_ddot_/_ddot_/_ddot_/nvidia/platform/t210/batuu/kernel-dts/camera-overlay-dione640.dtb"
```
